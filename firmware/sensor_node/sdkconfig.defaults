## firmware/sensor_node/sdkconfig.defaults
```kconfig
# ESP-IDF SDK Configuration Defaults for Sentinel-X ESP32-S3 Node
CONFIG_IDF_TARGET="esp32s3"

# System & Clock configuration
CONFIG_ESP32S3_DEFAULT_CPU_FREQ_240=y
CONFIG_ESP32S3_DATA_CACHE_32KB=y
CONFIG_ESP32S3_INSTRUCTION_CACHE_32KB=y

# FreeRTOS configuration
CONFIG_FREERTOS_HZ=1000
CONFIG_FREERTOS_UNICORE=n
CONFIG_TASK_WDT_PANIC=y
CONFIG_TASK_WDT_TIMEOUT_S=10

# Memory & Flash configuration
CONFIG_ESPTOOLPY_FLASHMODE_QIO=y
CONFIG_ESPTOOLPY_FLASHFREQ_80M=y
CONFIG_ESPTOOLPY_FLASHSIZE_8MB=y

# Security & eFuse
CONFIG_SECURE_BOOT_V2_ENABLED=y
CONFIG_SECURE_SIGNED_ON_BOOT=y
```
